## meta-rcar-gen3/wic/rcar-dualpart-noloader.wks
```
# short-description: Single partition rootfs with UUID and no bootloader
# long-description: Creates a partitioned image with a single partition in
# use and does not contain a bootloader.

part / --source rootfs --use-uuid --fstype=ext4 --label root --align 4096
# /data is 2GB
part /data             --use-uuid --fstype=vfat --label data --align 4096 --active --size 2048
```

## meta-rcar-gen3/wic/rcar-dualpart-noloader_ext4.wks
```
# short-description: Single partition rootfs with UUID and no bootloader
# long-description: Creates a partitioned image with a single partition in
# use and does not contain a bootloader.

part / --source rootfs --use-uuid --fstype=ext4 --label root --align 4096
# /data is 4GB
part /data --use-uuid --fstype=ext4 --label data --align 4096 --active --size 4096
```

## meta-rcar-gen3/wic/rcar-dualpart-noloader_ext4_8gb.wks
```
# short-description: Single partition rootfs with UUID and no bootloader
# long-description: Creates a partitioned image with a single partition in
# use and does not contain a bootloader.

# / is 8GB
part / --source rootfs --use-uuid --fstype=ext4 --label root --align 4096 --size 8192
# /data is 4GB
part /data --use-uuid --fstype=ext4 --label data --align 4096 --active --size 4096
```
